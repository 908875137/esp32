## sdkconfig.defaults
```kconfig
# ============================
# ThinkINK EPD — sdkconfig.defaults
# ESP32-S3 + 7.5" UC8179
# ============================

# ---- Bootloader ----
CONFIG_BOOTLOADER_LOG_LEVEL_NONE=y

# ---- Logging ----
CONFIG_LOG_DEFAULT_LEVEL_INFO=y

# ---- PSRAM (8MB Octal) ----
CONFIG_SPIRAM=y
CONFIG_ESP32S3_SPIRAM_SUPPORT=y
CONFIG_SPIRAM_MODE_OCT=y
CONFIG_SPIRAM_SPEED_80M=y
CONFIG_SPIRAM_USE_CAPS_ALLOC=y
CONFIG_SPIRAM_USE_MALLOC=y
CONFIG_SPIRAM_MALLOC_ALWAYSINTERNAL=4096
CONFIG_SPIRAM_ALLOW_BSS_SEG_EXTERNAL_MEMORY=y
CONFIG_SPIRAM_ALLOW_STACK_EXTERNAL_MEMORY=y

# ---- Flash (16MB QIO 80MHz) ----
CONFIG_ESPTOOLPY_FLASHSIZE_16MB=y
CONFIG_ESPTOOLPY_FLASHSIZE="16MB"
CONFIG_ESPTOOLPY_FLASHMODE_QIO=y
CONFIG_ESPTOOLPY_FLASHFREQ_80M=y

# ---- WiFi ----
CONFIG_ESP_WIFI_ENABLED=y
CONFIG_ESP_WIFI_STA_ENABLED=y
CONFIG_ESP_WIFI_SOFTAP_ENABLED=y
CONFIG_ESP_WIFI_STA_DISCONNECTED_PM_ENABLE=n

# ---- LWIP ----
CONFIG_LWIP_MAX_SOCKETS=12

# ---- HTTP Server (provisioning page) ----
CONFIG_HTTPD_MAX_REQ_HDR_LEN=512
CONFIG_HTTPD_MAX_URI_LEN=512

# ---- mbedTLS (HTTPS) ----
CONFIG_MBEDTLS_CERTIFICATE_BUNDLE=y
CONFIG_MBEDTLS_CERTIFICATE_BUNDLE_DEFAULT_FULL=y
CONFIG_MBEDTLS_TLS_ENABLED=y
CONFIG_MBEDTLS_SSL_PROTO_TLS1_2=y
CONFIG_MBEDTLS_TLS_CLIENT=y

# ---- NVS ----
CONFIG_NVS_ENCRYPTION=n

# ---- FreeRTOS ----
CONFIG_FREERTOS_HZ=100

# ---- Main task stack ----
CONFIG_ESP_MAIN_TASK_STACK_SIZE=24576
CONFIG_MAIN_TASK_STACK_SIZE=24576

# ---- Partition table (custom: 4MB factory + 4MB ota_0 + 4MB ota_1) ----
CONFIG_PARTITION_TABLE_CUSTOM=y
CONFIG_PARTITION_TABLE_CUSTOM_FILENAME="partitions.csv"
CONFIG_PARTITION_TABLE_FILENAME="partitions.csv"

# ---- OTA (dual-slot + bootloader rollback) ----
CONFIG_BOOTLOADER_APP_ROLLBACK_ENABLE=y

# ---- SPIFFS (font storage) ----
CONFIG_SPIFFS_MAX_PARTITIONS=3
CONFIG_SPIFFS_PAGE_SIZE=256
CONFIG_SPIFFS_OBJ_NAME_LEN=32
CONFIG_SPIFFS_USE_MAGIC=y
CONFIG_SPIFFS_USE_MAGIC_LENGTH=y
CONFIG_SPIFFS_USE_MTIME=y
```
